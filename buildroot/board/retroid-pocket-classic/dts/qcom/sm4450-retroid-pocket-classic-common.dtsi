// SPDX-License-Identifier: BSD-3-Clause
/*
 * Copyright (C) 2026-present ROCKNIX (https://github.com/ROCKNIX).
 *
 * Retroid Pocket Classic (SM4450 "parrot"): what every board revision shares.
 * Maintained by Banana as its own description of this handheld (it started as ROCKNIX's tree).
 *
 * One file per subsystem, included in this order (a file may only extend nodes from the ones
 * above it):
 *   -platform      SoC pieces mainline lacks, memory carve-outs, IOMMU, interconnects, QUP, SPMI
 *   -power         regulators, PMICs, battery/charger via pmic_glink, cpufreq
 *   -display       display controller, DSI, GPU
 *   -audio         ADSP, LPASS, SoundWire, headset codec, speaker amps, sound card
 *   -input         buttons, touchscreen, gamepad MCU UART
 *   -connectivity  Wi-Fi/Bluetooth (WCN3950), USB and Type-C
 *   -thermal       TSENS and thermal zones
 * Per-revision parts (panel, gamepad MCU, fan, GPIO banks) live in the .dts files.
 */

#include <dt-bindings/clock/qcom,dsi-phy-28nm.h>
#include <dt-bindings/clock/qcom,rpmh.h>
#include <dt-bindings/clock/qcom,sm4450-dispcc.h>
#include <dt-bindings/clock/qcom,sm4450-gcc.h>
#include <dt-bindings/clock/qcom,sm4450-gpucc.h>
#include <dt-bindings/dma/qcom-gpi.h>
#include <dt-bindings/gpio/gpio.h>
#include <dt-bindings/input/input.h>
#include <dt-bindings/interconnect/qcom,icc.h>
#include <dt-bindings/iio/qcom,spmi-adc7-pmk8350.h>
#include <dt-bindings/iio/qcom,spmi-vadc.h>
#include <dt-bindings/interconnect/qcom,sm4450-rpmh.h>
#include <dt-bindings/interrupt-controller/arm-gic.h>
#include <dt-bindings/mailbox/qcom-ipcc.h>
#include <dt-bindings/phy/phy-qcom-qmp.h>
#include <dt-bindings/pinctrl/qcom,pmic-gpio.h>
#include <dt-bindings/power/qcom,rpmhpd.h>
#include <dt-bindings/regulator/qcom,rpmh-regulator.h>
#include <dt-bindings/soc/qcom,gpr.h>
#include <dt-bindings/sound/qcom,q6dsp-lpass-ports.h>
#include <dt-bindings/spmi/spmi.h>
#include <dt-bindings/thermal/thermal.h>
#include "sm4450.dtsi"

#include "sm4450-retroid-pocket-classic-platform.dtsi"
#include "sm4450-retroid-pocket-classic-power.dtsi"
#include "sm4450-retroid-pocket-classic-display.dtsi"
#include "sm4450-retroid-pocket-classic-audio.dtsi"
#include "sm4450-retroid-pocket-classic-input.dtsi"
#include "sm4450-retroid-pocket-classic-connectivity.dtsi"
#include "sm4450-retroid-pocket-classic-thermal.dtsi"
