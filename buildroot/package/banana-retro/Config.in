## buildroot/package/banana-retro/Config.in
```kconfig
config BR2_PACKAGE_BANANA_RETRO
	bool "banana-retro"
	depends on BR2_TOOLCHAIN_HAS_THREADS
	depends on BR2_USE_MMU
	depends on !BR2_STATIC_LIBS
	select BR2_PACKAGE_BANANAD
	select BR2_PACKAGE_ALSA_LIB
	select BR2_PACKAGE_WAYLAND
	select BR2_PACKAGE_WAYLAND_PROTOCOLS
	help
	  Standalone Libretro runtime using the Wayland software presentation path.
	  This package is opt-in and does not change the board's RetroArch setup.
```

## buildroot/package/banana-ui/Config.in
```kconfig
config BR2_PACKAGE_BANANA_UI
	bool "banana-ui"
	depends on BR2_INSTALL_LIBSTDCPP
	depends on BR2_TOOLCHAIN_HAS_THREADS
	select BR2_PACKAGE_FREETYPE
	select BR2_PACKAGE_LIBDRM
	select BR2_PACKAGE_ALSA_LIB
	select BR2_PACKAGE_ZLIB
	# bananad stages the shared native-control wire header
	select BR2_PACKAGE_BANANAD
	help
	  Banana's frontend: ROCKNIXDS Pixel's engine drawn in software straight onto the panel.
```

## buildroot/package/pokedaisy/Config.in
```kconfig
config BR2_PACKAGE_POKEDAISY
	bool "pokedaisy"
	depends on BR2_INSTALL_LIBSTDCPP
	depends on BR2_TOOLCHAIN_HAS_THREADS
	select BR2_PACKAGE_SDL2
	help
	  PokeDaisy (github.com/lidor30/pokedaisy): a Game Boy / Game Boy Color / Game Boy Advance frontend with a live
	  Pokemon companion, as an app on the Apps shelf. The SDL2 host plus its mGBA (GB/GBC) and armGBA (GBA) libretro
	  cores. The DS core is not built yet. GPL-3.0; the NOTICE term "Based on PokeDaisy" applies.
```
